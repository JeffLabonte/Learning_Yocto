## conf/bblayers.conf
```bitbake
# POKY_BBLAYERS_CONF_VERSION is increased each time build/conf/bblayers.conf
# changes incompatibly
POKY_BBLAYERS_CONF_VERSION = "2"

BBPATH = "${TOPDIR}"
BBFILES ?= ""

BBLAYERS ?= " \
  /run/media/jflabonte/905d7ec3-b50b-48af-a4d6-246355f365b0/Yocto/poky/meta \
  /run/media/jflabonte/905d7ec3-b50b-48af-a4d6-246355f365b0/Yocto/poky/meta-poky \
  /run/media/jflabonte/905d7ec3-b50b-48af-a4d6-246355f365b0/Yocto/poky/meta-yocto-bsp \
  /run/media/jflabonte/905d7ec3-b50b-48af-a4d6-246355f365b0/Yocto/poky/meta-openembedded/meta-oe \
  /run/media/jflabonte/905d7ec3-b50b-48af-a4d6-246355f365b0/Yocto/poky/build/meta-own-layer \
  /run/media/jflabonte/905d7ec3-b50b-48af-a4d6-246355f365b0/Yocto/poky/meta-realtime \
  "
```

## meta-own-layer/conf/layer.conf
```bitbake
# We have a conf and classes directory, add to BBPATH
BBPATH .= ":${LAYERDIR}"

# We have recipes-* directories, add to BBFILES
BBFILES += "${LAYERDIR}/recipes-*/*/*.bb \
            ${LAYERDIR}/recipes-*/*/*.bbappend"

BBFILE_COLLECTIONS += "meta-own-layer"
BBFILE_PATTERN_meta-own-layer = "^${LAYERDIR}/"
BBFILE_PRIORITY_meta-own-layer = "6"

LAYERDEPENDS_meta-own-layer = "core"
LAYERSERIES_COMPAT_meta-own-layer = "warrior zeus"
```
